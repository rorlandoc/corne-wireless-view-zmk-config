## boards/shields/corne/Kconfig.shield
```kconfig
# No whitespace after the comma or in the keyboard name!
config SHIELD_CORNE_DONGLE
    def_bool $(shields_list_contains,my_corne_dongle)
```

## boards/shields/roccorne/Kconfig.shield
```kconfig
# No whitespace after the comma or in the keyboard name!
config SHIELD_ROCCORNE_DONGLE
    def_bool $(shields_list_contains,my_corne_dongle)
```

## boards/shields/rockeeb/Kconfig.defconfig
```kconfig
if SHIELD_ROCKEEB_DONGLE

config ZMK_KEYBOARD_NAME
    default "Corne"

config ZMK_SPLIT_ROLE_CENTRAL
    default y

config ZMK_USB
    default y

config ZMK_SPLIT
    default y

config ZMK_SPLIT_BLE_CENTRAL_PERIPHERALS
    default 2

# Set this to ZMK_SPLIT_BLE_CENTRAL_PERIPHERALS + your desired number of BT profiles (default is 5)
config BT_MAX_CONN
    default 5

# Set this to the same number as BT_MAX_CONN
config BT_MAX_PAIRED
    default 5

endif
```

## boards/shields/rockeeb/Kconfig.shield
```kconfig
config SHIELD_ROCKEEB_DONGLE
    def_bool $(shields_list_contains,rockeeb_dongle)
```

## config/west.yml
```yaml
manifest:
  remotes:
    - name: zmkfirmware
      url-base: https://github.com/zmkfirmware
    - name: rschenk
      url-base: https://github.com/rschenk
  projects:
    - name: zmk
      remote: zmkfirmware
      revision: v0.3
      import: app/west.yml
    - name: zmk-component-raytac-dongle
      remote: rschenk
      revision: main
  self:
    path: config
```
